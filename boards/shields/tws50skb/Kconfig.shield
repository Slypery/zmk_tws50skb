## boards/shields/tws50skb/Kconfig.shield
```kconfig
config SHIELD_TWS50SKB_LEFT
    def_bool $(shields_list_contains,tws50skb_left)

config SHIELD_TWS50SKB_RIGHT
    def_bool $(shields_list_contains,tws50skb_right)
```
