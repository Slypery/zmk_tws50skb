## boards/shields/tws50skb/Kconfig.defconfig
```kconfig
if SHIELD_TWS50SKB_LEFT || SHIELD_TWS50SKB_RIGHT || SHIELD_TWS50SKB_DONGLE

config ZMK_SPLIT
    default y

endif # SHIELD_TWS50SKB_LEFT || SHIELD_TWS50SKB_RIGHT || SHIELD_TWS50SKB_DONGLE

if SHIELD_TWS50SKB_LEFT || SHIELD_TWS50SKB_DONGLE

config ZMK_KEYBOARD_NAME
    default "tws50skb"

endif # SHIELD_TWS50SKB_LEFT || SHIELD_TWS50SKB_DONGLE

if SHIELD_TWS50SKB_DONGLE

config ZMK_SPLIT_ROLE_CENTRAL
    default y

config ZMK_SPLIT_BLE_CENTRAL_PERIPHERALS
    default 2

config BT_MAX_CONN
    default 7

config BT_MAX_PAIRED
    default 7

endif # SHIELD_TWS50SKB_DONGLE
```

## config/west.yml
```yaml
manifest:
  defaults:
    revision: v0.3
  remotes:
    - name: zmk
      url-base: https://github.com/Slypery
    # Additional modules containing boards/shields/custom code can be listed here as well
    # See https://docs.zephyrproject.org/3.2.0/develop/west/manifest.html#projects
    - name: maurzo
      url-base: https://github.com/maurzo
  projects:
    - name: zmk
      remote: zmk
      revision: debug-battery-discovery
      import: app/west.yml
    - name: zmk-behavior-battery-percentage-printer
      remote: maurzo
      revision: main
  self:
    path: config
```
